// SPDX-License-Identifier: (GPL-2.0 OR MIT)
/* Copyright (c) 2023 Spacemit, Inc */

/dts-v1/;

#include "k1-x.dtsi"

/ {
	model = "spacemit k1-x deb1 board";

	memory@0 {
		device_type = "memory";
		reg = <0x0 0x00000000 0x0 0x80000000>;
	};

	memory@100000000 {
		device_type = "memory";
		reg = <0x1 0x00000000 0x0 0x80000000>;
	};

	chosen {
		bootargs = "earlycon=sbi console=ttyS0,115200n8 loglevel=8 swiotlb=65536 rdinit=/init";
		stdout-path = "serial0:115200n8";
	};
};
